## main/Kconfig.projbuild
```kconfig
menu "MicroTech product integration"

choice MAIN_PROJECT_TASK_AFFINITY
    prompt "Project-owned task core affinity"
    default MAIN_PROJECT_TASK_AFFINITY_NO_AFFINITY
    help
        Select one core for tasks created by project-owned components. The
        default preserves scheduler freedom; diagnostic profiles may isolate
        application and service work from the LVGL worker.

config MAIN_PROJECT_TASK_AFFINITY_CPU0
    bool "CPU0"
    depends on !FREERTOS_UNICORE

config MAIN_PROJECT_TASK_AFFINITY_CPU1
    bool "CPU1"
    depends on !FREERTOS_UNICORE

config MAIN_PROJECT_TASK_AFFINITY_NO_AFFINITY
    bool "No affinity"

endchoice

config MAIN_PROJECT_TASK_CORE_ID
    hex
    default 0x0 if MAIN_PROJECT_TASK_AFFINITY_CPU0
    default 0x1 if MAIN_PROJECT_TASK_AFFINITY_CPU1
    default FREERTOS_NO_AFFINITY

config MAIN_DISPLAY_BENCHMARK
    bool "Enable the display benchmark product profile"
    depends on APP_MANAGER_DISPLAY_DIAGNOSTICS
    default n
    help
        Build the root-owned runtime benchmark from a generated typed profile.
        Production configurations must leave this disabled.

endmenu
```

## sdkconfig.defaults.esp32s3
```kconfig
# ESP32-S3 target profile for the Waveshare ESP32-S3-Touch-AMOLED-1.8 board.
CONFIG_BOARD_TYPE_WAVESHARE_ESP32_S3_TOUCH_AMOLED_1_8=y
CONFIG_ESP_WIFI_TASK_PINNED_TO_CORE_0=y
CONFIG_BT_CTRL_PINNED_TO_CORE_0=y
CONFIG_BT_NIMBLE_TRANSPORT_ACL_FROM_LL_COUNT=12
CONFIG_BT_NIMBLE_LL_CFG_FEAT_LE_CODED_PHY=n
CONFIG_BT_CTRL_BLE_MAX_ACT=2
CONFIG_BT_CTRL_BLE_SCAN_DUPL=n
CONFIG_BT_CTRL_LE_PING_EN=n
CONFIG_BT_CTRL_DTM_ENABLE=n
CONFIG_BT_CTRL_BLE_SCAN=n
CONFIG_SPIRAM_MODE_OCT=y
CONFIG_SPIRAM_SPEED_80M=y
CONFIG_ESP_DEFAULT_CPU_FREQ_MHZ_240=y
CONFIG_ESP32S3_INSTRUCTION_CACHE_32KB=y
CONFIG_ESP32S3_DATA_CACHE_64KB=y
CONFIG_ESP32S3_DATA_CACHE_LINE_64B=y
CONFIG_ESP_WIFI_STATIC_RX_BUFFER_NUM=6
CONFIG_ESP_WIFI_RX_MGMT_BUF_NUM_DEF=3
CONFIG_ESP_WIFI_MGMT_SBUF_NUM=16
CONFIG_ESP_WIFI_ENABLE_WPA3_OWE_STA=n
CONFIG_ESP_WIFI_GMAC_SUPPORT=n
CONFIG_ESP_WIFI_SOFTAP_SUPPORT=n
CONFIG_ESP_WIFI_ENTERPRISE_SUPPORT=n
CONFIG_ESP_WIFI_NVS_ENABLED=y
```
